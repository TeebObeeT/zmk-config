## app/boards/shields/keychron/b1/ergol/Kconfig.shield
```kconfig
# Copyright (c) 2024 Keychron
# SPDX-License-Identifier: MIT



config SHIELD_KEYCHRON_B1
    bool    

config SHIELD_KEYCHRON_B1_ISO_ERGOL
    def_bool $(shields_list_contains,keychron_b1_ISO_ergol)
    select SHIELD_KEYCHRON_B1
```

## app/west.yml
```yaml
manifest:
  remotes:
    - name: zephyrproject-rtos
      url-base: https://github.com/zephyrproject-rtos
    - name: zmkfirmware
      url-base: https://github.com/zmkfirmware
    - name: urob
      url-base: https://github.com/urob
  projects:
    - name: zephyr
      remote: zmkfirmware
      revision: v3.2.0+zmk-fixes
      clone-depth: 1
      import:
        name-blocklist:
          - ci-tools
          - hal_altera
          - hal_cypress
          - hal_infineon
          - hal_microchip
          - hal_nxp
          - hal_openisa
          - hal_silabs
          - hal_xtensa
          - hal_st
          - hal_ti
          - loramac-node
          - mcuboot
          - mcumgr
          - net-tools
          - openthread
          - edtt
          - trusted-firmware-m
          - sof
    - name: zmk-unicode
      remote: urob
      revision: v3.2.0+zmk-fixes # set to same as ZMK version above
  self:
    west-commands: scripts/west-commands.yml
    path: config
```
